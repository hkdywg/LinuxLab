/*
 *  uio.dts
 *  
 *  (C) 2024.12.09 <hkdywg@163.com>
 *
 *  This program is free software; you can redistribute it and/r modify
 *  it under the terms of the GNU General Public License version 2 as
 *  published by the Free Software Foundation.
 * */

/ {
    input_key {
    	compatible = "LinuxLab, input_key";
    	status = "okay";
		key = <0x8005 0x01 0x02>;
    };  
};
