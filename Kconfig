## Kconfig
```kconfig
#
# For a description of the synax of this configuration file
#


mainmenu "LinuxLab Configuration"

config MAIN_PROJ_NAME
    string "Project Name"
    default "LinuxLab"
    help
      Must be indicated project name.

choice
    prompt "Setup experiment platform"

config ARCH_ARM
    bool "config experiment platform on ARM"

config ARCH_ARM64
    bool "config experiment platform on ARM64"

endchoice

config ARCH
    string 
    default "arm" if ARCH_ARM
    default "arm64" if ARCH_ARM64

# Bootloader
source boot/Kconfig

# Filesystem
source fs/Kconfig

# ToolChain
source toolchain/Kconfig

# Kernel
source kernel/Kconfig

# Qemu
source rte/Kconfig
```

## boot/Kconfig
```kconfig
menuconfig UBOOT
    bool "u-boot"
    default y

if UBOOT

choice 
    prompt "Setup uboot source code"

config UBOOT_GITHUB
    bool "uboot source code from Github"

config UBOOT_DL
    bool "uboot source code firm External Package"

config UBOOT_WGET
    bool "uboot souce code from Wget"

endchoice

if UBOOT_GITHUB

config UBOOT_GITHUB_SITE
    string "uboot Github site"
    default "https://github.com/u-boot/u-boot.git"

endif #endif UBOOT_GITHUB

if UBOOT_DL

config UBOOT_DL_NAME
    string "External uboot absolute path"

endif #endif UBOOT_DL

if UBOOT_WGET

config UBOOT_WGET_SITE
    string "uboot wget site"
    default "ftp://ftp.denx.de/pub/u-boot/"

endif #endif UBOOT_WGET

config UBOOT_VERSION
    string "uboot version"
    default "u-boot-2021.07"

config UBOOT_SRC
    int
    default 1 if UBOOT_GITHUB
    default 2 if UBOOT_DL
    default 3 if UBOOT_WGET

choice 
    prompt "Choice CROSS compile"

config UBOOT_CROSS_GNUEABI
    bool "arm-linux-gnueabi"
    select TOOL_ARM_GNUEABI

config UBOOT_CROSS_GNUEABIHF
    bool "arm-linux-gnueabihf"
    select TOOL_ARM_GNUEABIHF

config UBOOT_CROSS_GNUARM64
    bool "aarch64-linux-gnu"
    select TOOL_ARM_GNUARM64

endchoice
    
config UBOOT_CROSS_COMPILE
    string
    default "arm-linux-gnueabi" if UBOOT_CROSS_GNUEABI
    default "arm-linux-gnueabihf" if UBOOT_CROSS_GNUEABIHF
    default "aarch64-linux-gnu" if UBOOT_CROSS_GNUARM64 

config UBOOT_DEFCONFIG
    string "uboot default defconfig"
    default "vexpress_aemv8a_semi_defconfig"


endif #endif UBOOT
```

## kernel/Kconfig
```kconfig
menu"linux kernel" 
choice 
    prompt "Setup linux kernel source code"

config LINUX_KERNEL_GITHUB
    bool "linux kernel source code form github"

config LINUX_KERNEL_DL
    bool "linux kernel source code form external package"

config LINUX_KERNEL_WGET
    bool "linux kernel source code from wget"

endchoice

choice 
    prompt "select linux kernel version"

config LINUX_KERNEL_VERSION-4.14
    bool "linux kernel 4.14 version"

config LINUX_KERNEL_VERSION-4.19
    bool "linux kernel 4.19 version"

config LINUX_KERNEL_VERSION-5.4
    bool "linux kernel 5.4 version"

endchoice

config LINUX_KERNEL_VERSION
    string 
    default "4.14" if LINUX_KERNEL_VERSION-4.14
    default "4.19" if LINUX_KERNEL_VERSION-4.19
    default "5.4" if LINUX_KERNEL_VERSION-5.4

if LINUX_KERNEL_DL

config LINUX_KERNEL_DL_NAME
    string "external linux kernel absolute path"

endif #LINUX_KERNEL_DL

config LINUX_KERNEL_GITHUB_SITE
    string
    default "https://gitee.com/mirrors/linux.git" if LINUX_KERNEL_GITHUB


if LINUX_KERNEL_WGET

config LINUX_KERNEL_WGET_SITE
    string 
    default "https://mirrors.edge.kernel.org/pub/linux/kernel/v4.x"  if LINUX_KERNEL_VERSION-4.14
    default "https://mirrors.edge.kernel.org/pub/linux/kernel/v4.x"  if LINUX_KERNEL_VERSION-4.19
    default "https://mirrors.edge.kernel.org/pub/linux/kernel/v5.x"  if LINUX_KERNEL_VERSION-5.4

endif #LINUX_KERNEL_WGET


config LINUX_KERNEL_SRC
    int 
    default 1 if LINUX_KERNEL_GITHUB
    default 2 if LINUX_KERNEL_DL
    default 3 if LINUX_KERNEL_WGET


choice
    prompt "Choice Cross compile"

config LINUX_KERNEL_CROSS_COMPILE_GNUEABI
    bool "arm-linux-gnueabi"

config LINUX_KERNEL_CROSS_COMPILE_GNUEABIHF
    bool "arm-linux-gnueabihf"

config LINUX_KERNEL_CROSS_COMPILE_AARCH64
    bool "aarch64-linux-gnu"

endchoice

config LINUX_KERNEL_CROSS_COMPILE
    string
    default "arm-linux-gnueabi" if LINUX_KERNEL_CROSS_COMPILE_GNUEABI
    default "arm-linux-gnueabihf" if LINUX_KERNEL_CROSS_COMPILE_GNUEABIHF
    default "aarch64-linux-gnu" if LINUX_KERNEL_CROSS_COMPILE_AARCH64

config KERNEL_DEFCONFIG
    string "kernel default defconfig"
    default "defconfig"

endmenu
```

## package/Kconfig
```kconfig
menuconfig PACKAGE
    bool "PACKAGE"
    default y

if PACKAGE

config PACKAGE_KDUMP
    default true
    bool "Linux kernel kdump experiment"


endif #endif PACKAGE
```

## rte/Kconfig
```kconfig
menuconfig RTE
    bool "RTE"
    default y

if RTE


choice 
    prompt "Setup RTE qemu source code"

config QEMU_GITHUB
    bool "qemu source code from Github"

config QEMU_WGET
    bool "qemu source code from wget"

endchoice

config QEMU_SRC
    int
    default 1 if QEMU_GITHUB
    default 2 if QEMU_WGET

config QEMU_VERSION
    string "qemu version"
    default "7.1.0"

config RAM_SIZE
    default 256
    int "The ram size of system(MB)"

config CPU_CORE
    string "cpu core type"
    default "cortex-a53"

config CPU_CORE_NUM
    int "cput core number"
    default 2

endif #endif RTE
```

## toolchain/Kconfig
```kconfig
#
# Host Compiler toolchain
#

menuconfig TOOLCHAIN
    bool "Compiler toolchain"
    default y

if TOOLCHAIN

# ARM gnueabi
source toolchain/arm-linux-gnueabi/Kconfig

# Arm gnueabihf
source toolchain/arm-linux-gnueabihf/Kconfig

# ARM aarch64
source toolchain/aarch64-linux-gnu/Kconfig

endif
```

## toolchain/aarch64-linux-gnu/Kconfig
```kconfig
menuconfig TOOL_AARCH64
    bool "aarch64-linux-gnu"

if TOOL_AARCH64

choice
    prompt "Setup way to get aarch64-linux-gnu"

config TOOL_AARCH64_DL
    bool "aarch64-linux-gnu from external file"

config TOOL_AARCH64_WGET
    bool "aarch64-linux-gnu from wget"

endchoice

config TOOL_AARCH64_SRC
    int 
    default 1 if TOOL_AARCH64_DL
    default 2 if TOOL_AARCH64_WGET

if TOOL_AARCH64_WGET
choice 
    prompt "Release Version"

config AARCH64_V7.4-2019.02
    bool "v7.4-2019.02"

endchoice

config AARCH64_FULL_NAME
    string
    default "7.4-2019.02/aarch64-linux-gnu/gcc-linaro-7.4.1-2019.02-x86_64_aarch64-linux-gnu.tar.xz" if AARCH64_V7.4-2019.02

endif   # endif TOOL_AARCH64_SRC


config AARCH64_VERSION
    string
    default "v7.4-2019.02"

endif # endif TOOL_AARCH64
```

## toolchain/arm-linux-gnueabi/Kconfig
```kconfig
menuconfig TOOL_ARM_GNUEABI
    bool "arm-linux-gnueabi"

if TOOL_ARM_GNUEABI

choice
    prompt "Setup way to get arm-linux-gnu"

config TOOL_ARM_GNUEABI_DL
    bool "arm-linux-gnueabi from external file"

config TOOL_ARM_GNUEABI_WGET
    bool "arm-linux-gnueabi from wget"

endchoice

config TOOL_ARM_GNUEABI_SRC
    int 
    default 1 if TOOL_ARM_GNUEABI_DL
    default 2 if TOOL_ARM_GNUEABI_WGET

if TOOL_ARM_GNUEABI_WGET
choice 
    prompt "Release Version"

config ARM_GNUEABI_V7.4-2019.02
    bool "v7.4-2019.02"

endchoice

config ARM_GNUEABI_FULL_NAME
    string
    default "7.4-2019.02/arm-linux-gnueabi/gcc-linaro-7.4.1-2019.02-x86_64_arm-linux-gnueabi.tar.xz" if ARM_GNUEABI_V7.4-2019.02

endif   # endif TOOL_ARM_GNUEABI_SRC


if TOOL_ARM_GNUEABI_DL
config ARM_GNUEABI_VERSION
    string
    default "v7.4-2019.02"
endif # endif TOOL_ARM_GNUEABI_DL

endif # endif TOOL_ARM_GNUEABI
```

## toolchain/arm-linux-gnueabihf/Kconfig
```kconfig
menuconfig TOOL_ARM_GNUEABIHF
    bool "arm-linux-gnueabihf"

if TOOL_ARM_GNUEABIHF

choice
    prompt "Setup way to get arm-linux-gnu"

config TOOL_ARM_GNUEABIHF_DL
    bool "arm-linux-gnueabihf from external file"

config TOOL_ARM_GNUEABIHF_WGET
    bool "arm-linux-gnueabihf from wget"

endchoice

config TOOL_ARM_GNUEABIHF_SRC
    int 
    default 1 if TOOL_ARM_GNUEABIHF_DL
    default 2 if TOOL_ARM_GNUEABIHF_WGET

if TOOL_ARM_GNUEABIHF_WGET
choice 
    prompt "Release Version"

config ARM_GNUEABIHF_V7.4-2019.02
    bool "v7.4-2019.02"

endchoice

config ARM_GNUEABIHF_FULL_NAME
    string
    default "7.4-2019.02/arm-linux-gnueabihf/gcc-linaro-7.4.1-2019.02-x86_64_arm-linux-gnueabihf.tar.xz" if ARM_GNUEABIHF_V7.4-2019.02

endif   # endif TOOL_ARM_GNUEABIHF_SRC


if TOOL_ARM_GNUEABIHF_DL
config ARM_GNUEABIHF_VERSION
    string
    default "v7.4-2019.02"
endif # endif TOOL_ARM_GNUEABIHF_DL

endif # endif TOOL_ARM_GNUEABIHF
```
