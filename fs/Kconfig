## fs/Kconfig
```kconfig
#
# Rootfs configure menu
#

menuconfig ROOTFS
    bool "Root-filesystem"
    default -y
    help
        The rootfs for LinuxLab

if ROOTFS

choice
     prompt "Select rootfs style"
 
config BUSYBOX_ROOT_FS
    bool "Tiny rootfs by busybox"

config BUILD_ROOT_FS
    bool "Embedded relatively complete file system by buildroot"

config DEBIAN_ROOT_FS
    bool "Debian rootfs"

endchoice

if BUSYBOX_ROOT_FS
    source fs/busybox/Kconfig
endif

if BUILD_ROOT_FS
    source fs/buildroot/Kconfig
endif

if DEBIAN_ROOT_FS
    source fs/debian/Kconfig
endif

config ROOTFS_SIZE
    default 150
    int "The size of Rootfs (MB)"

config FREEZE_SIZE
    default 512
    int "The size of Freeze Disk (MB)"

endif # ROOTFS
```

## fs/buildroot/Kconfig
```kconfig
#
# Rootfs configure menu
#

choice
    prompt "Setup buildroot source code"

config BUILDROOT_GITHUB
    bool "buildroot source code from Github"

config BUILDROOT_WGET
    bool "buildroot source code from Wget"

endchoice

config BUILDROOT_SRC
    int
    default 1 if BUILDROOT_GITHUB
    default 2 if BUILDROOT_WGET

config BUILDROOT_VERSION
    string "buildroot version"
    default "2021.05"

config BUILDROOT_DEFCONFIG
    string "buildroot default config"
    default "qemu_aarch64_virt_defconfig"
```

## fs/busybox/Kconfig
```kconfig
#
# Rootfs configure menu
#

choice
    prompt "Setup busybox source code"

config BUSYBOX_GITHUB
    bool "busybox source code from Github"

config BUSYBOX_WGET
    bool "busybox source code from Wget"

endchoice

config BUSYBOX_SRC
    int
    default 1 if BUSYBOX_GITHUB
    default 2 if BUSYBOX_WGET

config BUSYBOX_VERSION
    string "busybox version"
    default "1.24.2"

config BUSYBOX_DEFCONFIG
    string "busyxbox default config"
    default "TEST_rh9_defconfig"
```
